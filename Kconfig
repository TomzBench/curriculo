## Kconfig
```kconfig
mainmenu "Qwiet Configuration"

choice PLATFORM
    prompt "Target Platform"
    default PLATFORM_LINUX

config PLATFORM_LINUX
    bool "Linux Desktop"
    help
      Build for standard Linux desktop environment.

config PLATFORM_PINENOTE
    bool "PineNote"
    help
      Build for PineNote e-ink tablet.
      Uses Linux platform traits.

endchoice

source "platform/Kconfig"

menuconfig TESTING
    bool "Testing Support"
    default n
    help
      Enable test framework support (Unity/CMock).

if TESTING
    source "tests/diode/Kconfig"
endif
```

## platform/Kconfig
```kconfig
menu "Platform Abstraction Layer"

source "platform/posix/Kconfig"
source "platform/linux/Kconfig"

endmenu
```

## platform/linux/Kconfig
```kconfig
config PAL_LINUX
    bool "Linux trait"
    default y if PLATFORM_LINUX || PLATFORM_PINENOTE
    select PAL_POSIX
    help
      Include Linux-specific APIs (evdev, timer, event).

if PAL_LINUX

config PAL_LINUX_EVDEV
    bool "evdev input support"
    default y
    help
      Enable libevdev-based input handling.

config PAL_LINUX_TIMER
    bool "Timer support"
    default y

config PAL_LINUX_EVENT
    bool "Event support"
    default y

endif # PAL_LINUX
```

## platform/posix/Kconfig
```kconfig
config PAL_POSIX
    bool "POSIX trait"
    default y if PLATFORM_LINUX || PLATFORM_PINENOTE
    help
      Include POSIX-compatible APIs (net, sem, time).

if PAL_POSIX

config PAL_POSIX_NET
    bool "Network support"
    default y

config PAL_POSIX_SEM
    bool "Semaphore support"
    default y

config PAL_POSIX_TIME
    bool "Time support"
    default y

endif # PAL_POSIX
```

## tests/diode/Kconfig
```kconfig
config DIODE_TEST_NET
    bool "Network mock tests"
    default y
    depends on PAL_POSIX_NET

config DIODE_TEST_EVDEV
    bool "evdev mock tests"
    default y
    depends on PAL_LINUX_EVDEV
```
